## firmware/dualeye/main/Kconfig.projbuild
```kconfig
menu "Atlas Rover Mk.1"

    config ATLAS_DISPLAY_WAVESHARE_LVGL
        bool "Use Waveshare DualEye GC9A01/LVGL display backend"
        default y
        help
            Initialize the ESP32-S3-DualEye-Touch-LCD-1.28 dual GC9A01
            240x240 LCDs and render Atlas expression frames with LVGL.
            If hardware initialization fails at runtime, the firmware falls
            back to the serial log renderer.

endmenu
```

## firmware/dualeye/sdkconfig.defaults
```kconfig
CONFIG_IDF_TARGET="esp32s3"
CONFIG_ESPTOOLPY_FLASHSIZE_16MB=y
CONFIG_ESPTOOLPY_FLASHSIZE="16MB"
CONFIG_PARTITION_TABLE_CUSTOM=y
CONFIG_PARTITION_TABLE_CUSTOM_FILENAME="partitions.csv"
CONFIG_PARTITION_TABLE_FILENAME="partitions.csv"
CONFIG_ESP_DEFAULT_CPU_FREQ_MHZ_240=y
CONFIG_ESPTOOLPY_FLASHMODE_QIO=y
CONFIG_SPIRAM=y
CONFIG_SPIRAM_MODE_OCT=y
CONFIG_SPIRAM_SPEED_80M=y
CONFIG_SPIRAM_BOOT_INIT=y
CONFIG_SPIRAM_USE_MALLOC=y
CONFIG_FREERTOS_TASK_CREATE_ALLOW_EXT_MEM=y
CONFIG_SPIRAM_TRY_ALLOCATE_WIFI_LWIP=y
CONFIG_ESP32S3_DATA_CACHE_64KB=y
CONFIG_ESP32S3_DATA_CACHE_SIZE=0x20000
CONFIG_ESP32S3_DATA_CACHE_LINE_64B=y
CONFIG_ESP32S3_DATA_CACHE_LINE_SIZE=64
CONFIG_LV_USE_USER_DATA=y
CONFIG_LV_COLOR_16_SWAP=y
CONFIG_LV_FONT_MONTSERRAT_12=y
CONFIG_LV_FONT_MONTSERRAT_14=y
CONFIG_LV_FONT_MONTSERRAT_24=y
CONFIG_LV_FONT_MONTSERRAT_28=y
CONFIG_LV_FONT_MONTSERRAT_36=y
CONFIG_LV_FONT_SIMSUN_16_CJK=y
CONFIG_LV_FONT_FMT_TXT_LARGE=y
CONFIG_LV_USE_FONT_COMPRESSED=y
# CONFIG_LV_USE_FONT_PLACEHOLDER is not set
CONFIG_LV_USE_PNG=y
CONFIG_LV_MEM_CUSTOM=y
CONFIG_LV_MEM_CUSTOM_INCLUDE="stdlib.h"
CONFIG_LV_IMG_CACHE_DEF_SIZE=4
CONFIG_SPIFFS_OBJ_NAME_LEN=64
CONFIG_HTTPD_WS_SUPPORT=y

# ESP-SR P3 resource validation. This packages a small built-in WakeNet model
# into the model partition so /api/sr/status can verify real model loading.
CONFIG_MODEL_IN_FLASH=y
CONFIG_SR_WN_WN9_NIHAOXIAOZHI_TTS=y
```
